#include "VGA.h"
#include <stdio.h>      /* printf, scanf, puts, NULL */
#include <stdlib.h>     /* srand, rand */
#include <time.h>  

#define LineAmount 6
#define ObstaculeAmount 4
#define XPositionAmount 3
#define PointInRectangle(x, y, x1, y1, x2, y2)		((( (x) >= (x1)) && ((y) >= (y1))) && (((x) <= (x2)) && ((y) <= (y2))))
int y =0;
int x=0;
int object=0;
int CarAnimation=0;
int Lives=3;
int Score=0;
int PersonAnimation=0;
int HeartAnimation=0;
int obstaculeToInstantIndex=1;
int Start=0;
boolean TrafficLight=false;
int arrow=0;
boolean about=false;
boolean FinishGame=false;

struct Rectangle {
		unsigned int x1, y1, x2, y2;
};



int Collide(struct Rectangle *r1, struct Rectangle *r2)
{
	return (PointInRectangle(r1->x1, r1->y1, r2->x1, r2->y1, r2->x2, r2->y2) ||
		PointInRectangle(r1->x2, r1->y2, r2->x1, r2->y1, r2->x2, r2->y2) ||
		PointInRectangle(r1->x1, r1->y2, r2->x1, r2->y1, r2->x2, r2->y2) ||
		PointInRectangle(r1->x2, r1->y1, r2->x1, r2->y1, r2->x2, r2->y2));
}
struct Sprite{
  int posX;
  int posY;
  int width;
  int height;
  unsigned char *image;
  
};
unsigned char small_ball[] = { 
    RED, RED, RED, RED, RED, WHITE , 
    RED, RED, RED, RED, RED, WHITE , 
    RED, RED, RED, RED, RED, WHITE , 
    RED, RED, RED, RED, RED, WHITE , 
    RED, RED, RED, RED, RED, WHITE , 
    WHITE, WHITE, WHITE, WHITE, WHITE, WHITE,
};
struct Obstacule{
  int posX;
  int posY;
  int XPosiblePosition[XPositionAmount];
  int width ;
  int height;
  unsigned char *objectToInstantiate;
};
struct Line{
  int y1;
  int x1;
  int x2;
  int y2;
};

unsigned char Intro[]={
  YELLOW,YELLOW,YELLOW,YELLOW,YELLOW,YELLOW,YELLOW,YELLOW,YELLOW,YELLOW,YELLOW,YELLOW,YELLOW,YELLOW,YELLOW,YELLOW,YELLOW,YELLOW,YELLOW,YELLOW,YELLOW,YELLOW,YELLOW,YELLOW,YELLOW,YELLOW,YELLOW,YELLOW,YELLOW,YELLOW,YELLOW,YELLOW,YELLOW,YELLOW,YELLOW,YELLOW,YELLOW,YELLOW,YELLOW,YELLOW,YELLOW,YELLOW,YELLOW,YELLOW,YELLOW,YELLOW,YELLOW,YELLOW,YELLOW,YELLOW,YELLOW,YELLOW,YELLOW,YELLOW,YELLOW,YELLOW,YELLOW,YELLOW,YELLOW,YELLOW,YELLOW,YELLOW,YELLOW,YELLOW,YELLOW,YELLOW,YELLOW,YELLOW,YELLOW,YELLOW,YELLOW,YELLOW,YELLOW,YELLOW,YELLOW,YELLOW,YELLOW,YELLOW,YELLOW,YELLOW,
  YELLOW,YELLOW,YELLOW,YELLOW,YELLOW,YELLOW,YELLOW,YELLOW,YELLOW,YELLOW,YELLOW,YELLOW,YELLOW,YELLOW,YELLOW,YELLOW,YELLOW,YELLOW,YELLOW,YELLOW,YELLOW,YELLOW,YELLOW,YELLOW,YELLOW,YELLOW,YELLOW,YELLOW,YELLOW,YELLOW,YELLOW,YELLOW,RED,BLACK,BLACK,BLACK,BLACK,BLACK,BLACK,RED,RED,BLACK,BLACK,BLACK,BLACK,BLACK,BLACK,RED,YELLOW,YELLOW,YELLOW,YELLOW,YELLOW,YELLOW,YELLOW,YELLOW,YELLOW,YELLOW,YELLOW,YELLOW,YELLOW,YELLOW,YELLOW,YELLOW,YELLOW,YELLOW,YELLOW,YELLOW,YELLOW,YELLOW,YELLOW,YELLOW,YELLOW,YELLOW,YELLOW,YELLOW,YELLOW,YELLOW,YELLOW,YELLOW,
  WHITE,WHITE,WHITE,WHITE,BLACK,BLACK,BLACK,BLACK,WHITE,WHITE,WHITE,WHITE,BLACK,BLACK,BLACK,BLACK,WHITE,WHITE,WHITE,WHITE,BLACK,BLACK,BLACK,BLACK,YELLOW,YELLOW,YELLOW,YELLOW,YELLOW,YELLOW,YELLOW,YELLOW,RED,BLACK,BLACK,BLACK,BLACK,BLACK,RED,BLACK,BLACK,RED,BLACK,BLACK,BLACK,BLACK,BLACK,RED,YELLOW,YELLOW,YELLOW,YELLOW,YELLOW,YELLOW,YELLOW,YELLOW,BLACK,BLACK,BLACK,BLACK,WHITE,WHITE,WHITE,WHITE,BLACK,BLACK,BLACK,BLACK,WHITE,WHITE,WHITE,WHITE,BLACK,BLACK,BLACK,BLACK,WHITE,WHITE,WHITE,WHITE,
  WHITE,WHITE,WHITE,WHITE,BLACK,BLACK,BLACK,BLACK,WHITE,WHITE,WHITE,WHITE,BLACK,BLACK,BLACK,BLACK,WHITE,WHITE,WHITE,WHITE,BLACK,BLACK,BLACK,BLACK,YELLOW,YELLOW,YELLOW,YELLOW,YELLOW,YELLOW,YELLOW,YELLOW,RED,BLACK,BLACK,BLACK,BLACK,BLACK,RED,BLACK,BLACK,RED,BLACK,BLACK,BLACK,BLACK,BLACK,RED,YELLOW,YELLOW,YELLOW,YELLOW,YELLOW,YELLOW,YELLOW,YELLOW,BLACK,BLACK,BLACK,BLACK,WHITE,WHITE,WHITE,WHITE,BLACK,BLACK,BLACK,BLACK,WHITE,WHITE,WHITE,WHITE,BLACK,BLACK,BLACK,BLACK,WHITE,WHITE,WHITE,WHITE,
  YELLOW,YELLOW,YELLOW,YELLOW,YELLOW,YELLOW,YELLOW,YELLOW,YELLOW,YELLOW,YELLOW,YELLOW,YELLOW,YELLOW,YELLOW,YELLOW,YELLOW,YELLOW,YELLOW,YELLOW,YELLOW,YELLOW,YELLOW,YELLOW,YELLOW,YELLOW,YELLOW,YELLOW,YELLOW,YELLOW,YELLOW,YELLOW,RED,YELLOW,YELLOW,YELLOW,YELLOW,YELLOW,RED,WHITE,WHITE,RED,YELLOW,YELLOW,YELLOW,YELLOW,YELLOW,RED,YELLOW,YELLOW,YELLOW,YELLOW,YELLOW,YELLOW,YELLOW,YELLOW,YELLOW,YELLOW,YELLOW,YELLOW,YELLOW,YELLOW,YELLOW,YELLOW,YELLOW,YELLOW,YELLOW,YELLOW,YELLOW,YELLOW,YELLOW,YELLOW,YELLOW,YELLOW,YELLOW,YELLOW,YELLOW,YELLOW,YELLOW,YELLOW,
  YELLOW,YELLOW,YELLOW,YELLOW,YELLOW,YELLOW,YELLOW,YELLOW,YELLOW,YELLOW,YELLOW,YELLOW,YELLOW,YELLOW,YELLOW,YELLOW,YELLOW,YELLOW,YELLOW,YELLOW,YELLOW,YELLOW,YELLOW,YELLOW,YELLOW,YELLOW,YELLOW,YELLOW,YELLOW,YELLOW,YELLOW,YELLOW,RED,YELLOW,YELLOW,YELLOW,YELLOW,YELLOW,WHITE,WHITE,WHITE,WHITE,YELLOW,YELLOW,YELLOW,YELLOW,YELLOW,RED,YELLOW,YELLOW,YELLOW,YELLOW,YELLOW,YELLOW,YELLOW,YELLOW,YELLOW,YELLOW,YELLOW,YELLOW,YELLOW,YELLOW,YELLOW,YELLOW,YELLOW,YELLOW,YELLOW,YELLOW,YELLOW,YELLOW,YELLOW,YELLOW,YELLOW,YELLOW,YELLOW,YELLOW,YELLOW,YELLOW,YELLOW,YELLOW,
  YELLOW,YELLOW,YELLOW,YELLOW,YELLOW,YELLOW,YELLOW,YELLOW,YELLOW,YELLOW,YELLOW,YELLOW,YELLOW,YELLOW,YELLOW,YELLOW,YELLOW,YELLOW,YELLOW,YELLOW,YELLOW,YELLOW,YELLOW,YELLOW,YELLOW,YELLOW,YELLOW,YELLOW,YELLOW,YELLOW,YELLOW,YELLOW,RED,YELLOW,YELLOW,YELLOW,YELLOW,YELLOW,WHITE,WHITE,WHITE,WHITE,YELLOW,YELLOW,YELLOW,YELLOW,YELLOW,RED,YELLOW,YELLOW,YELLOW,YELLOW,YELLOW,YELLOW,YELLOW,YELLOW,YELLOW,YELLOW,YELLOW,YELLOW,YELLOW,YELLOW,YELLOW,YELLOW,YELLOW,YELLOW,YELLOW,YELLOW,YELLOW,YELLOW,YELLOW,YELLOW,YELLOW,YELLOW,YELLOW,YELLOW,YELLOW,YELLOW,YELLOW,YELLOW,
  YELLOW,YELLOW,YELLOW,YELLOW,YELLOW,YELLOW,YELLOW,YELLOW,YELLOW,YELLOW,YELLOW,YELLOW,YELLOW,YELLOW,YELLOW,YELLOW,YELLOW,YELLOW,YELLOW,YELLOW,YELLOW,YELLOW,YELLOW,YELLOW,YELLOW,YELLOW,YELLOW,YELLOW,YELLOW,YELLOW,YELLOW,BLACK,BLACK,BLACK,YELLOW,YELLOW,YELLOW,YELLOW,BLACK,BLACK,BLACK,BLACK,YELLOW,YELLOW,YELLOW,YELLOW,BLACK,BLACK,BLACK,YELLOW,YELLOW,YELLOW,YELLOW,YELLOW,YELLOW,YELLOW,YELLOW,YELLOW,YELLOW,YELLOW,YELLOW,YELLOW,YELLOW,YELLOW,YELLOW,YELLOW,YELLOW,YELLOW,YELLOW,YELLOW,YELLOW,YELLOW,YELLOW,YELLOW,YELLOW,YELLOW,YELLOW,YELLOW,YELLOW,YELLOW,
  YELLOW,YELLOW,YELLOW,YELLOW,YELLOW,YELLOW,YELLOW,YELLOW,YELLOW,YELLOW,YELLOW,YELLOW,YELLOW,YELLOW,YELLOW,YELLOW,YELLOW,YELLOW,YELLOW,YELLOW,YELLOW,YELLOW,YELLOW,YELLOW,YELLOW,YELLOW,YELLOW,YELLOW,YELLOW,YELLOW,YELLOW,YELLOW,RED,YELLOW,YELLOW,YELLOW,RED,RED,RED,WHITE,WHITE,RED,RED,RED,YELLOW,YELLOW,YELLOW,RED,YELLOW,YELLOW,YELLOW,YELLOW,YELLOW,YELLOW,YELLOW,YELLOW,YELLOW,YELLOW,YELLOW,YELLOW,YELLOW,YELLOW,YELLOW,YELLOW,YELLOW,YELLOW,YELLOW,YELLOW,YELLOW,YELLOW,YELLOW,YELLOW,YELLOW,YELLOW,YELLOW,YELLOW,YELLOW,YELLOW,YELLOW,YELLOW,
  YELLOW,YELLOW,YELLOW,YELLOW,YELLOW,YELLOW,YELLOW,YELLOW,YELLOW,YELLOW,YELLOW,YELLOW,YELLOW,YELLOW,YELLOW,YELLOW,YELLOW,YELLOW,YELLOW,YELLOW,YELLOW,YELLOW,WHITE,WHITE,WHITE,WHITE,WHITE,WHITE,YELLOW,YELLOW,YELLOW,YELLOW,RED,YELLOW,YELLOW,YELLOW,RED,RED,RED,WHITE,WHITE,RED,RED,RED,YELLOW,YELLOW,YELLOW,RED,YELLOW,YELLOW,YELLOW,YELLOW,WHITE,WHITE,WHITE,WHITE,WHITE,WHITE,YELLOW,YELLOW,YELLOW,YELLOW,YELLOW,YELLOW,YELLOW,YELLOW,YELLOW,YELLOW,YELLOW,YELLOW,YELLOW,YELLOW,YELLOW,YELLOW,YELLOW,YELLOW,YELLOW,YELLOW,YELLOW,YELLOW,
  YELLOW,YELLOW,YELLOW,YELLOW,YELLOW,YELLOW,YELLOW,YELLOW,YELLOW,YELLOW,YELLOW,YELLOW,YELLOW,YELLOW,YELLOW,YELLOW,YELLOW,YELLOW,YELLOW,YELLOW,YELLOW,YELLOW,BLACK,BLACK,BLACK,BLACK,BLACK,BLACK,RED,RED,RED,RED,RED,RED,RED,RED,RED,RED,RED,WHITE,WHITE,RED,RED,RED,RED,RED,RED,RED,RED,RED,RED,RED,BLACK,BLACK,BLACK,BLACK,BLACK,BLACK,YELLOW,YELLOW,YELLOW,YELLOW,YELLOW,YELLOW,YELLOW,YELLOW,YELLOW,YELLOW,YELLOW,YELLOW,YELLOW,YELLOW,YELLOW,YELLOW,YELLOW,YELLOW,YELLOW,YELLOW,YELLOW,YELLOW,
  YELLOW,YELLOW,YELLOW,YELLOW,YELLOW,YELLOW,YELLOW,YELLOW,YELLOW,YELLOW,YELLOW,YELLOW,YELLOW,YELLOW,YELLOW,YELLOW,YELLOW,YELLOW,YELLOW,YELLOW,YELLOW,YELLOW,BLACK,BLACK,BLACK,BLACK,BLACK,BLACK,RED,RED,RED,RED,RED,RED,RED,RED,RED,WHITE,WHITE,WHITE,WHITE,WHITE,WHITE,RED,RED,RED,RED,RED,RED,RED,RED,RED,BLACK,BLACK,BLACK,BLACK,BLACK,BLACK,YELLOW,YELLOW,YELLOW,YELLOW,YELLOW,YELLOW,YELLOW,YELLOW,YELLOW,YELLOW,YELLOW,YELLOW,YELLOW,YELLOW,YELLOW,YELLOW,YELLOW,YELLOW,YELLOW,YELLOW,YELLOW,YELLOW,
  YELLOW,YELLOW,YELLOW,YELLOW,YELLOW,YELLOW,YELLOW,YELLOW,YELLOW,YELLOW,YELLOW,YELLOW,YELLOW,YELLOW,YELLOW,YELLOW,YELLOW,YELLOW,YELLOW,YELLOW,YELLOW,YELLOW,BLACK,BLACK,BLACK,BLACK,BLACK,BLACK,WHITE,WHITE,WHITE,WHITE,WHITE,BLACK,BLACK,RED,RED,WHITE,WHITE,WHITE,WHITE,WHITE,WHITE,BLACK,BLACK,WHITE,WHITE,WHITE,WHITE,WHITE,WHITE,WHITE,BLACK,BLACK,BLACK,BLACK,BLACK,BLACK,YELLOW,YELLOW,YELLOW,YELLOW,YELLOW,YELLOW,YELLOW,YELLOW,YELLOW,YELLOW,YELLOW,YELLOW,YELLOW,YELLOW,YELLOW,YELLOW,YELLOW,YELLOW,YELLOW,YELLOW,YELLOW,YELLOW,
  YELLOW,YELLOW,YELLOW,YELLOW,YELLOW,YELLOW,YELLOW,YELLOW,YELLOW,YELLOW,YELLOW,YELLOW,YELLOW,YELLOW,YELLOW,YELLOW,YELLOW,YELLOW,YELLOW,YELLOW,YELLOW,YELLOW,BLACK,BLACK,BLACK,BLACK,BLACK,BLACK,WHITE,WHITE,WHITE,WHITE,WHITE,BLACK,BLACK,RED,RED,WHITE,WHITE,WHITE,WHITE,WHITE,WHITE,BLACK,BLACK,WHITE,WHITE,WHITE,WHITE,WHITE,WHITE,WHITE,BLACK,BLACK,BLACK,BLACK,BLACK,BLACK,YELLOW,YELLOW,YELLOW,YELLOW,YELLOW,YELLOW,YELLOW,YELLOW,YELLOW,YELLOW,YELLOW,YELLOW,YELLOW,YELLOW,YELLOW,YELLOW,YELLOW,YELLOW,YELLOW,YELLOW,YELLOW,YELLOW,
  YELLOW,YELLOW,YELLOW,YELLOW,YELLOW,YELLOW,YELLOW,YELLOW,YELLOW,YELLOW,YELLOW,YELLOW,YELLOW,YELLOW,YELLOW,YELLOW,YELLOW,YELLOW,YELLOW,YELLOW,YELLOW,YELLOW,BLACK,BLACK,BLACK,BLACK,BLACK,BLACK,WHITE,WHITE,BLACK,BLACK,BLACK,BLACK,WHITE,RED,RED,RED,RED,RED,RED,RED,RED,WHITE,BLACK,BLACK,BLACK,BLACK,BLACK,BLACK,WHITE,WHITE,BLACK,BLACK,BLACK,BLACK,BLACK,BLACK,YELLOW,YELLOW,YELLOW,YELLOW,YELLOW,YELLOW,YELLOW,YELLOW,YELLOW,YELLOW,YELLOW,YELLOW,YELLOW,YELLOW,YELLOW,YELLOW,YELLOW,YELLOW,YELLOW,YELLOW,YELLOW,YELLOW,
  YELLOW,YELLOW,YELLOW,YELLOW,YELLOW,YELLOW,YELLOW,YELLOW,YELLOW,YELLOW,YELLOW,YELLOW,YELLOW,YELLOW,YELLOW,YELLOW,YELLOW,YELLOW,YELLOW,YELLOW,YELLOW,YELLOW,BLACK,BLACK,BLACK,BLACK,BLACK,BLACK,WHITE,WHITE,BLACK,BLACK,BLACK,BLACK,WHITE,RED,RED,RED,RED,RED,RED,RED,RED,WHITE,BLACK,BLACK,BLACK,BLACK,BLACK,BLACK,WHITE,WHITE,BLACK,BLACK,BLACK,BLACK,BLACK,BLACK,YELLOW,YELLOW,YELLOW,YELLOW,YELLOW,YELLOW,YELLOW,YELLOW,YELLOW,YELLOW,YELLOW,YELLOW,YELLOW,YELLOW,YELLOW,YELLOW,YELLOW,YELLOW,YELLOW,YELLOW,YELLOW,YELLOW,
  YELLOW,YELLOW,YELLOW,YELLOW,YELLOW,YELLOW,YELLOW,YELLOW,YELLOW,YELLOW,YELLOW,YELLOW,YELLOW,YELLOW,YELLOW,YELLOW,YELLOW,YELLOW,YELLOW,YELLOW,YELLOW,YELLOW,BLACK,BLACK,BLACK,BLACK,BLACK,BLACK,BLACK,BLACK,BLACK,BLACK,BLACK,BLACK,WHITE,RED,RED,WHITE,WHITE,WHITE,WHITE,RED,RED,WHITE,BLACK,BLACK,BLACK,BLACK,BLACK,BLACK,BLACK,BLACK,BLACK,BLACK,BLACK,BLACK,BLACK,BLACK,YELLOW,YELLOW,YELLOW,YELLOW,YELLOW,YELLOW,YELLOW,YELLOW,YELLOW,YELLOW,YELLOW,YELLOW,YELLOW,YELLOW,YELLOW,YELLOW,YELLOW,YELLOW,YELLOW,YELLOW,YELLOW,YELLOW,
  YELLOW,YELLOW,YELLOW,YELLOW,YELLOW,YELLOW,YELLOW,YELLOW,YELLOW,YELLOW,YELLOW,YELLOW,YELLOW,YELLOW,YELLOW,YELLOW,YELLOW,YELLOW,YELLOW,YELLOW,YELLOW,YELLOW,BLACK,BLACK,BLACK,BLACK,BLACK,BLACK,YELLOW,YELLOW,BLACK,BLACK,BLACK,BLACK,WHITE,RED,RED,WHITE,WHITE,WHITE,WHITE,RED,RED,WHITE,BLACK,BLACK,BLACK,BLACK,BLACK,BLACK,YELLOW,YELLOW,BLACK,BLACK,BLACK,BLACK,BLACK,BLACK,YELLOW,YELLOW,YELLOW,YELLOW,YELLOW,YELLOW,YELLOW,YELLOW,YELLOW,YELLOW,YELLOW,YELLOW,YELLOW,YELLOW,YELLOW,YELLOW,YELLOW,YELLOW,YELLOW,YELLOW,YELLOW,YELLOW,
  YELLOW,YELLOW,YELLOW,YELLOW,YELLOW,YELLOW,YELLOW,YELLOW,YELLOW,YELLOW,YELLOW,YELLOW,YELLOW,YELLOW,YELLOW,YELLOW,YELLOW,YELLOW,YELLOW,YELLOW,YELLOW,YELLOW,RED,RED,RED,RED,WHITE,WHITE,WHITE,WHITE,WHITE,WHITE,WHITE,BLACK,WHITE,RED,RED,WHITE,WHITE,WHITE,WHITE,RED,RED,WHITE,BLACK,WHITE,WHITE,WHITE,WHITE,WHITE,WHITE,WHITE,WHITE,WHITE,RED,RED,RED,RED,YELLOW,YELLOW,YELLOW,YELLOW,YELLOW,YELLOW,YELLOW,YELLOW,YELLOW,YELLOW,YELLOW,YELLOW,YELLOW,YELLOW,YELLOW,YELLOW,YELLOW,YELLOW,YELLOW,YELLOW,YELLOW,YELLOW,
  YELLOW,YELLOW,YELLOW,YELLOW,YELLOW,YELLOW,YELLOW,YELLOW,YELLOW,YELLOW,YELLOW,YELLOW,YELLOW,YELLOW,YELLOW,YELLOW,YELLOW,YELLOW,YELLOW,YELLOW,YELLOW,YELLOW,BLACK,BLACK,RED,RED,RED,RED,WHITE,WHITE,WHITE,WHITE,WHITE,WHITE,RED,RED,RED,RED,RED,RED,RED,RED,RED,RED,WHITE,WHITE,WHITE,WHITE,WHITE,WHITE,WHITE,WHITE,RED,RED,RED,RED,BLACK,BLACK,YELLOW,YELLOW,YELLOW,YELLOW,YELLOW,YELLOW,YELLOW,YELLOW,YELLOW,YELLOW,YELLOW,YELLOW,YELLOW,YELLOW,YELLOW,YELLOW,YELLOW,YELLOW,YELLOW,YELLOW,YELLOW,YELLOW,
  YELLOW,YELLOW,YELLOW,YELLOW,YELLOW,YELLOW,YELLOW,YELLOW,YELLOW,YELLOW,YELLOW,YELLOW,YELLOW,YELLOW,YELLOW,YELLOW,YELLOW,YELLOW,YELLOW,YELLOW,YELLOW,YELLOW,BLACK,BLACK,BLACK,RED,RED,RED,RED,RED,RED,RED,RED,RED,RED,RED,RED,RED,RED,RED,RED,RED,RED,RED,RED,RED,RED,RED,RED,RED,RED,RED,RED,RED,RED,BLACK,BLACK,BLACK,YELLOW,YELLOW,YELLOW,YELLOW,YELLOW,YELLOW,YELLOW,YELLOW,YELLOW,YELLOW,YELLOW,YELLOW,YELLOW,YELLOW,YELLOW,YELLOW,YELLOW,YELLOW,YELLOW,YELLOW,YELLOW,YELLOW,
};

unsigned char Car[] = { 
    BLACK, BLACK,BLACK, BLACK, BLACK, BLACK, BLACK, BLACK, RED, RED, RED, RED, BLACK, BLACK, BLACK, BLACK, BLACK, BLACK, BLACK, BLACK,
    BLACK, BLACK,BLACK, BLACK, BLACK, BLACK, BLACK, BLACK, RED, BLACK, BLACK, RED, BLACK, BLACK, BLACK, BLACK, BLACK, BLACK, BLACK, BLACK,
    BLACK, BLACK, BLACK,CYAN, CYAN, YELLOW, YELLOW, CYAN, RED, RED, RED, RED, CYAN, YELLOW, YELLOW, CYAN, CYAN, BLACK, BLACK, BLACK,
    BLACK, BLACK,BLACK, CYAN, BLUE, BLUE, BLUE, BLUE, RED, RED, RED, RED, BLUE, BLUE, BLUE, BLUE, CYAN, BLACK, BLACK, BLACK,
    BLACK, BLACK,BLACK, CYAN, BLUE, BLUE, BLUE, RED, RED, RED, RED, RED, RED, BLUE, BLUE, BLUE, CYAN, BLACK, BLACK, BLACK,
    BLACK, BLACK,BLACK, CYAN, CYAN, CYAN, CYAN, RED, RED, RED, RED, RED, RED, CYAN, CYAN, CYAN, CYAN, BLACK, BLACK, BLACK,
    BLACK, BLACK, BLACK,BLACK, BLACK, BLACK, BLACK, RED, RED, RED, RED, RED, RED, BLACK, BLACK, BLACK, BLACK, BLACK, BLACK, BLACK,
    BLACK, BLACK, BLACK,BLACK, BLACK, BLACK, BLACK, RED, RED, RED, RED, RED, RED, BLACK, BLACK, BLACK, BLACK, BLACK, BLACK, BLACK,
    BLACK, BLACK, BLACK, BLACK,BLACK, BLACK, BLACK, RED, RED, RED, RED, RED, RED, BLACK, BLACK, BLACK, BLACK, BLACK, BLACK,  BLACK,
    BLACK, BLACK, BLACK, BLACK, WHITE, WHITE, BLACK, RED, RED, RED, RED, RED, RED, BLACK, WHITE, WHITE, BLACK, BLACK, BLACK,  BLACK,
    BLACK, BLACK, BLACK, WHITE,PURPLE, PURPLE, BLACK, RED, RED, WHITE, WHITE, RED, RED, BLACK, PURPLE, PURPLE, WHITE, BLACK, BLACK,  BLACK,
    BLACK, BLACK, BLACK, WHITE,PURPLE, PURPLE, BLACK, RED, RED, WHITE, WHITE, RED, RED, BLACK, PURPLE, PURPLE, WHITE, BLACK, BLACK,  BLACK,
    BLACK, BLACK, BLACK, WHITE,PURPLE, PURPLE, BLACK, RED, RED, WHITE, WHITE, RED, RED, BLACK, PURPLE, PURPLE, WHITE, BLACK, BLACK,  BLACK,
    BLACK, BLACK, BLACK, BLACK,BLACK, BLACK, BLACK, RED, RED, WHITE, WHITE, RED, RED, BLACK, BLACK, BLACK, BLACK, BLACK, BLACK,  BLACK,
    BLACK, BLACK, BLACK, BLACK,BLACK, BLACK, BLACK, RED, RED, WHITE, WHITE, RED, RED, BLACK, BLACK, BLACK, BLACK, BLACK, BLACK,  BLACK,
    BLACK, BLACK, BLACK,BLACK, BLACK, BLACK, BLACK, RED, RED, WHITE, WHITE, RED, RED, BLACK, BLACK, BLACK, BLACK, BLACK, BLACK,  BLACK,
    BLACK, BLACK, BLACK, BLACK,BLACK, BLACK, BLACK, RED, RED, WHITE, WHITE, RED, RED, BLACK, BLACK, BLACK, BLACK, BLACK, BLACK,  BLACK,
    BLACK, BLACK, BLACK, BLACK,BLACK, BLACK, BLACK, RED, RED, BLACK, BLACK, RED, RED, BLACK, BLACK, BLACK, BLACK, BLACK, BLACK,  BLACK,
    BLACK, BLACK, BLACK, BLACK,BLACK, BLACK, BLACK, RED, BLACK, BLACK, BLACK, BLACK, RED, BLACK, BLACK, BLACK, BLACK, BLACK, BLACK,  BLACK,
    BLACK, BLACK, BLACK,BLACK,RED, RED, RED, RED, BLACK, BLACK, BLACK, BLACK, RED, RED, RED, RED, BLACK, BLACK, BLACK,  BLACK,
    BLACK, WHITE, WHITE, BLACK,RED, RED, RED, RED, BLACK, BLACK, BLACK, BLACK, RED, RED, RED, RED, BLACK, WHITE, WHITE,   BLACK,
    WHITE, PURPLE, PURPLE,BLACK, RED, RED, RED, RED, RED, WHITE, WHITE, RED, RED, RED, RED, RED, BLACK, PURPLE, PURPLE, WHITE,//HERE
    WHITE, PURPLE, PURPLE, BLACK,RED, RED, RED, RED, RED, WHITE, WHITE, RED, RED, RED, RED, RED, BLACK, PURPLE, PURPLE,  WHITE,
    WHITE, PURPLE, PURPLE, BLACK,RED, RED, RED, RED, RED, WHITE, WHITE, RED, RED, RED, RED, RED, BLACK, PURPLE, PURPLE,  WHITE,
    WHITE, PURPLE, PURPLE, BLACK,RED, RED, RED, RED, RED, WHITE, WHITE, RED, RED, RED, RED, RED, BLACK, PURPLE, PURPLE,  WHITE,
    BLACK, BLACK, BLACK, BLACK,RED, RED, RED, RED, RED, WHITE, WHITE, RED, RED, RED, RED, RED, BLACK, BLACK, BLACK, BLACK, //HERE 
    BLACK, BLACK, BLACK,BLACK, BLACK, BLACK, BLACK, WHITE, BLACK, BLACK, BLACK, BLACK, WHITE, BLACK, BLACK, BLACK, BLACK, BLACK, BLACK, BLACK, 
    BLACK, BLACK, BLACK,BLACK, BLACK, RED, RED, RED, RED, RED, RED, RED, RED, RED, RED, BLACK, BLACK, BLACK, BLACK, BLACK,
    BLACK, BLACK, BLACK, BLACK,BLACK, RED, RED, RED, RED, RED, RED, RED, RED, RED, RED, BLACK, BLACK, BLACK, BLACK, BLACK, 
    
};

unsigned char TrafficLightGreen[] = { 
     WHITE, WHITE, BLACK, BLACK, BLACK, BLACK, BLACK, BLACK, BLACK, BLACK, BLACK, BLACK, BLACK, BLACK, WHITE, WHITE, 
     WHITE, BLACK, BLACK, BLACK, BLACK, BLACK, BLACK, RED,RED, BLACK, BLACK, BLACK, BLACK, BLACK, BLACK, WHITE,  
     BLACK, BLACK, BLACK, BLACK, BLACK, BLACK, RED, BLACK, BLACK, RED, BLACK, BLACK, BLACK, BLACK, BLACK, BLACK, 
     BLACK, BLACK, BLACK, BLACK, BLACK, RED, BLACK, BLACK, BLACK, BLACK, RED, BLACK, BLACK, BLACK, BLACK, BLACK, 
     BLACK, BLACK, BLACK, BLACK, RED, BLACK, BLACK, BLACK, BLACK, BLACK, BLACK, RED, BLACK, BLACK, BLACK, BLACK, 
     BLACK, BLACK, BLACK, BLACK, RED, BLACK, BLACK, BLACK, BLACK, BLACK, BLACK, RED, BLACK, BLACK, BLACK, BLACK, 
     BLACK, BLACK, BLACK, BLACK, BLACK, RED, BLACK, BLACK, BLACK, BLACK, RED, BLACK, BLACK, BLACK, BLACK, BLACK,  
     BLACK, BLACK, BLACK, BLACK, BLACK, BLACK, RED, BLACK, BLACK, RED, BLACK, BLACK, BLACK, BLACK, BLACK, BLACK,  
     BLACK, BLACK, BLACK, BLACK, BLACK, BLACK, BLACK, RED, RED, BLACK, BLACK, BLACK, BLACK, BLACK, BLACK, BLACK,  
     BLACK, BLACK, BLACK, BLACK, BLACK, BLACK, BLACK, BLACK, BLACK, BLACK, BLACK, BLACK, BLACK, BLACK, BLACK, BLACK, 
     BLACK, BLACK, BLACK, BLACK, BLACK, BLACK, BLACK, BLACK, BLACK, BLACK, BLACK, BLACK, BLACK, BLACK, BLACK, BLACK,  
     BLACK, BLACK, BLACK, BLACK, BLACK, BLACK, BLACK, YELLOW,YELLOW, BLACK, BLACK, BLACK, BLACK, BLACK, BLACK, BLACK,  
     BLACK, BLACK, BLACK, BLACK, BLACK, BLACK, YELLOW, BLACK, BLACK, YELLOW, BLACK, BLACK, BLACK, BLACK, BLACK, BLACK,  
     BLACK, BLACK, BLACK, BLACK, BLACK, YELLOW, BLACK, BLACK, BLACK, BLACK, YELLOW, BLACK, BLACK, BLACK, BLACK, BLACK,  
     BLACK, BLACK, BLACK, BLACK, YELLOW, BLACK, BLACK, BLACK, BLACK, BLACK, BLACK, YELLOW, BLACK, BLACK, BLACK, BLACK, 
     BLACK, BLACK, BLACK, BLACK, YELLOW, BLACK, BLACK, BLACK, BLACK, BLACK, BLACK, YELLOW, BLACK, BLACK, BLACK, BLACK,  
     BLACK, BLACK, BLACK, BLACK, BLACK, YELLOW, BLACK, BLACK, BLACK, BLACK, YELLOW, BLACK, BLACK, BLACK, BLACK, BLACK,  
     BLACK, BLACK, BLACK, BLACK, BLACK, BLACK, YELLOW, BLACK, BLACK, YELLOW, BLACK, BLACK, BLACK, BLACK, BLACK, BLACK, 
     BLACK, BLACK, BLACK, BLACK, BLACK, BLACK, BLACK, YELLOW, YELLOW, BLACK, BLACK, BLACK, BLACK, BLACK, BLACK, BLACK, 
     BLACK, BLACK, BLACK, BLACK, BLACK, BLACK, BLACK, BLACK, BLACK, BLACK, BLACK, BLACK, BLACK, BLACK, BLACK, BLACK, 
     BLACK, BLACK, BLACK, BLACK, BLACK, BLACK, BLACK, BLACK, BLACK, BLACK, BLACK, BLACK, BLACK, BLACK, BLACK, BLACK,  
     BLACK, BLACK, BLACK, BLACK, BLACK, BLACK, BLACK, GREEN,GREEN, BLACK, BLACK, BLACK, BLACK, BLACK, BLACK, BLACK, 
     BLACK, BLACK, BLACK, BLACK, BLACK, BLACK, GREEN, GREEN, GREEN, GREEN, BLACK, BLACK, BLACK, BLACK, BLACK, BLACK, 
     BLACK, BLACK, BLACK, BLACK, BLACK, GREEN, GREEN, GREEN, GREEN, GREEN, GREEN, BLACK, BLACK, BLACK, BLACK, BLACK, 
     BLACK, BLACK, BLACK, BLACK, GREEN, GREEN, GREEN, GREEN, GREEN, GREEN, GREEN, GREEN, BLACK, BLACK, BLACK, BLACK, 
     BLACK, BLACK, BLACK, BLACK, GREEN, GREEN, GREEN, GREEN, GREEN, GREEN, GREEN, GREEN, BLACK, BLACK, BLACK, BLACK, 
     BLACK, BLACK, BLACK, BLACK, BLACK, GREEN, GREEN, GREEN, GREEN, GREEN, GREEN, BLACK, BLACK, BLACK, BLACK, BLACK,  
     BLACK, BLACK, BLACK, BLACK, BLACK, BLACK, GREEN, GREEN, GREEN, GREEN, BLACK, BLACK, BLACK, BLACK, BLACK, BLACK,
     WHITE, BLACK, BLACK, BLACK, BLACK, BLACK, BLACK, GREEN, GREEN, BLACK, BLACK, BLACK, BLACK, BLACK, BLACK, WHITE,  
     WHITE, WHITE, BLACK, BLACK, BLACK, BLACK, BLACK, BLACK, BLACK, BLACK, BLACK, BLACK, BLACK, BLACK, WHITE, WHITE, 
    
};

unsigned char TrafficLightYellow[] = { 
     WHITE, WHITE, BLACK, BLACK, BLACK, BLACK, BLACK, BLACK, BLACK, BLACK, BLACK, BLACK, BLACK, BLACK, WHITE, WHITE, 
     WHITE, BLACK, BLACK, BLACK, BLACK, BLACK, BLACK, RED,RED, BLACK, BLACK, BLACK, BLACK, BLACK, BLACK, WHITE,  
     BLACK, BLACK, BLACK, BLACK, BLACK, BLACK, RED, BLACK, BLACK, RED, BLACK, BLACK, BLACK, BLACK, BLACK, BLACK, 
     BLACK, BLACK, BLACK, BLACK, BLACK, RED, BLACK, BLACK, BLACK, BLACK, RED, BLACK, BLACK, BLACK, BLACK, BLACK, 
     BLACK, BLACK, BLACK, BLACK, RED, BLACK, BLACK, BLACK, BLACK, BLACK, BLACK, RED, BLACK, BLACK, BLACK, BLACK, 
     BLACK, BLACK, BLACK, BLACK, RED, BLACK, BLACK, BLACK, BLACK, BLACK, BLACK, RED, BLACK, BLACK, BLACK, BLACK, 
     BLACK, BLACK, BLACK, BLACK, BLACK, RED, BLACK, BLACK, BLACK, BLACK, RED, BLACK, BLACK, BLACK, BLACK, BLACK,  
     BLACK, BLACK, BLACK, BLACK, BLACK, BLACK, RED, BLACK, BLACK, RED, BLACK, BLACK, BLACK, BLACK, BLACK, BLACK,  
     BLACK, BLACK, BLACK, BLACK, BLACK, BLACK, BLACK, RED, RED, BLACK, BLACK, BLACK, BLACK, BLACK, BLACK, BLACK,  
     BLACK, BLACK, BLACK, BLACK, BLACK, BLACK, BLACK, BLACK, BLACK, BLACK, BLACK, BLACK, BLACK, BLACK, BLACK, BLACK, 
     BLACK, BLACK, BLACK, BLACK, BLACK, BLACK, BLACK, BLACK, BLACK, BLACK, BLACK, BLACK, BLACK, BLACK, BLACK, BLACK,  
     BLACK, BLACK, BLACK, BLACK, BLACK, BLACK, BLACK, YELLOW,YELLOW, BLACK, BLACK, BLACK, BLACK, BLACK, BLACK, BLACK,  
     BLACK, BLACK, BLACK, BLACK, BLACK, BLACK, YELLOW, YELLOW, YELLOW, YELLOW, BLACK, BLACK, BLACK, BLACK, BLACK, BLACK,  
     BLACK, BLACK, BLACK, BLACK, BLACK, YELLOW, YELLOW, YELLOW, YELLOW, YELLOW, YELLOW, BLACK, BLACK, BLACK, BLACK, BLACK,  
     BLACK, BLACK, BLACK, BLACK, YELLOW, YELLOW, YELLOW, YELLOW, YELLOW, YELLOW, YELLOW, YELLOW, BLACK, BLACK, BLACK, BLACK, 
     BLACK, BLACK, BLACK, BLACK, YELLOW, YELLOW, YELLOW, YELLOW, YELLOW, YELLOW, YELLOW, YELLOW, BLACK, BLACK, BLACK, BLACK,  
     BLACK, BLACK, BLACK, BLACK, BLACK, YELLOW, YELLOW, YELLOW, YELLOW, YELLOW, YELLOW, BLACK, BLACK, BLACK, BLACK, BLACK,  
     BLACK, BLACK, BLACK, BLACK, BLACK, BLACK, YELLOW, YELLOW, YELLOW, YELLOW, BLACK, BLACK, BLACK, BLACK, BLACK, BLACK, 
     BLACK, BLACK, BLACK, BLACK, BLACK, BLACK, BLACK, YELLOW, YELLOW, BLACK, BLACK, BLACK, BLACK, BLACK, BLACK, BLACK, 
     BLACK, BLACK, BLACK, BLACK, BLACK, BLACK, BLACK, BLACK, BLACK, BLACK, BLACK, BLACK, BLACK, BLACK, BLACK, BLACK, 
     BLACK, BLACK, BLACK, BLACK, BLACK, BLACK, BLACK, BLACK, BLACK, BLACK, BLACK, BLACK, BLACK, BLACK, BLACK, BLACK,  
     BLACK, BLACK, BLACK, BLACK, BLACK, BLACK, BLACK, GREEN,GREEN, BLACK, BLACK, BLACK, BLACK, BLACK, BLACK, BLACK, 
     BLACK, BLACK, BLACK, BLACK, BLACK, BLACK, GREEN, BLACK, BLACK, GREEN, BLACK, BLACK, BLACK, BLACK, BLACK, BLACK, 
     BLACK, BLACK, BLACK, BLACK, BLACK, GREEN, BLACK, BLACK, BLACK, BLACK, GREEN, BLACK, BLACK, BLACK, BLACK, BLACK, 
     BLACK, BLACK, BLACK, BLACK, GREEN, BLACK, BLACK, BLACK, BLACK, BLACK, BLACK, GREEN, BLACK, BLACK, BLACK, BLACK, 
     BLACK, BLACK, BLACK, BLACK, GREEN, BLACK, BLACK, BLACK, BLACK, BLACK, BLACK, GREEN, BLACK, BLACK, BLACK, BLACK, 
     BLACK, BLACK, BLACK, BLACK, BLACK, GREEN, BLACK, BLACK, BLACK, BLACK, GREEN, BLACK, BLACK, BLACK, BLACK, BLACK,  
     BLACK, BLACK, BLACK, BLACK, BLACK, BLACK, GREEN, BLACK, BLACK, GREEN, BLACK, BLACK, BLACK, BLACK, BLACK, BLACK,
     WHITE, BLACK, BLACK, BLACK, BLACK, BLACK, BLACK, GREEN, GREEN, BLACK, BLACK, BLACK, BLACK, BLACK, BLACK, WHITE,  
     WHITE, WHITE, BLACK, BLACK, BLACK, BLACK, BLACK, BLACK, BLACK, BLACK, BLACK, BLACK, BLACK, BLACK, WHITE, WHITE, 
    
};
unsigned char TrafficLightRed[] = { 
     WHITE, WHITE, BLACK, BLACK, BLACK, BLACK, BLACK, BLACK, BLACK, BLACK, BLACK, BLACK, BLACK, BLACK, WHITE, WHITE, 
     WHITE, BLACK, BLACK, BLACK, BLACK, BLACK, BLACK, RED,RED, BLACK, BLACK, BLACK, BLACK, BLACK, BLACK, WHITE,  
     BLACK, BLACK, BLACK, BLACK, BLACK, BLACK, RED, RED, RED, RED, BLACK, BLACK, BLACK, BLACK, BLACK, BLACK, 
     BLACK, BLACK, BLACK, BLACK, BLACK, RED, RED, RED, RED, RED, RED, BLACK, BLACK, BLACK, BLACK, BLACK, 
     BLACK, BLACK, BLACK, BLACK, RED, RED, RED, RED, RED, RED, RED, RED, BLACK, BLACK, BLACK, BLACK, 
     BLACK, BLACK, BLACK, BLACK, RED, RED, RED, RED, RED, RED, RED, RED, BLACK, BLACK, BLACK, BLACK, 
     BLACK, BLACK, BLACK, BLACK, BLACK, RED, RED, RED, RED, RED, RED, BLACK, BLACK, BLACK, BLACK, BLACK,  
     BLACK, BLACK, BLACK, BLACK, BLACK, BLACK, RED, RED, RED, RED, BLACK, BLACK, BLACK, BLACK, BLACK, BLACK,  
     BLACK, BLACK, BLACK, BLACK, BLACK, BLACK, BLACK, RED, RED, BLACK, BLACK, BLACK, BLACK, BLACK, BLACK, BLACK,  
     BLACK, BLACK, BLACK, BLACK, BLACK, BLACK, BLACK, BLACK, BLACK, BLACK, BLACK, BLACK, BLACK, BLACK, BLACK, BLACK, 
     BLACK, BLACK, BLACK, BLACK, BLACK, BLACK, BLACK, BLACK, BLACK, BLACK, BLACK, BLACK, BLACK, BLACK, BLACK, BLACK,  
     BLACK, BLACK, BLACK, BLACK, BLACK, BLACK, BLACK, YELLOW,YELLOW, BLACK, BLACK, BLACK, BLACK, BLACK, BLACK, BLACK,  
     BLACK, BLACK, BLACK, BLACK, BLACK, BLACK, YELLOW, BLACK, BLACK, YELLOW, BLACK, BLACK, BLACK, BLACK, BLACK, BLACK,  
     BLACK, BLACK, BLACK, BLACK, BLACK, YELLOW, BLACK, BLACK, BLACK, BLACK, YELLOW, BLACK, BLACK, BLACK, BLACK, BLACK,  
     BLACK, BLACK, BLACK, BLACK, YELLOW, BLACK, BLACK, BLACK, BLACK, BLACK, BLACK, YELLOW, BLACK, BLACK, BLACK, BLACK, 
     BLACK, BLACK, BLACK, BLACK, YELLOW, BLACK, BLACK, BLACK, BLACK, BLACK, BLACK, YELLOW, BLACK, BLACK, BLACK, BLACK,  
     BLACK, BLACK, BLACK, BLACK, BLACK, YELLOW, BLACK, BLACK, BLACK, BLACK, YELLOW, BLACK, BLACK, BLACK, BLACK, BLACK,  
     BLACK, BLACK, BLACK, BLACK, BLACK, BLACK, YELLOW, BLACK, BLACK, YELLOW, BLACK, BLACK, BLACK, BLACK, BLACK, BLACK, 
     BLACK, BLACK, BLACK, BLACK, BLACK, BLACK, BLACK, YELLOW, YELLOW, BLACK, BLACK, BLACK, BLACK, BLACK, BLACK, BLACK, 
     BLACK, BLACK, BLACK, BLACK, BLACK, BLACK, BLACK, BLACK, BLACK, BLACK, BLACK, BLACK, BLACK, BLACK, BLACK, BLACK, 
     BLACK, BLACK, BLACK, BLACK, BLACK, BLACK, BLACK, BLACK, BLACK, BLACK, BLACK, BLACK, BLACK, BLACK, BLACK, BLACK,  
     BLACK, BLACK, BLACK, BLACK, BLACK, BLACK, BLACK, GREEN,GREEN, BLACK, BLACK, BLACK, BLACK, BLACK, BLACK, BLACK, 
     BLACK, BLACK, BLACK, BLACK, BLACK, BLACK, GREEN, BLACK, BLACK, GREEN, BLACK, BLACK, BLACK, BLACK, BLACK, BLACK, 
     BLACK, BLACK, BLACK, BLACK, BLACK, GREEN, BLACK, BLACK, BLACK, BLACK, GREEN, BLACK, BLACK, BLACK, BLACK, BLACK, 
     BLACK, BLACK, BLACK, BLACK, GREEN, BLACK, BLACK, BLACK, BLACK, BLACK, BLACK, GREEN, BLACK, BLACK, BLACK, BLACK, 
     BLACK, BLACK, BLACK, BLACK, GREEN, BLACK, BLACK, BLACK, BLACK, BLACK, BLACK, GREEN, BLACK, BLACK, BLACK, BLACK, 
     BLACK, BLACK, BLACK, BLACK, BLACK, GREEN, BLACK, BLACK, BLACK, BLACK, GREEN, BLACK, BLACK, BLACK, BLACK, BLACK,  
     BLACK, BLACK, BLACK, BLACK, BLACK, BLACK, GREEN, BLACK, BLACK, GREEN, BLACK, BLACK, BLACK, BLACK, BLACK, BLACK,
     WHITE, BLACK, BLACK, BLACK, BLACK, BLACK, BLACK, GREEN, GREEN, BLACK, BLACK, BLACK, BLACK, BLACK, BLACK, WHITE,  
     WHITE, WHITE, BLACK, BLACK, BLACK, BLACK, BLACK, BLACK, BLACK, BLACK, BLACK, BLACK, BLACK, BLACK, WHITE, WHITE, 
    
};

unsigned char Car2[] = { 
    BLACK, BLACK,BLACK, BLACK, BLACK, BLACK, BLACK, BLACK, BLUE, BLUE, BLUE, BLUE, BLACK, BLACK, BLACK, BLACK, BLACK, BLACK, BLACK, BLACK,
    BLACK, BLACK,BLACK, BLACK, BLACK, BLACK, BLACK, BLACK, BLUE, BLACK, BLACK, BLUE, BLACK, BLACK, BLACK, BLACK, BLACK, BLACK, BLACK, BLACK,
    BLACK, BLACK, BLACK,CYAN, CYAN, YELLOW, YELLOW, CYAN, BLUE, BLUE, BLUE, BLUE, CYAN, YELLOW, YELLOW, CYAN, CYAN, BLACK, BLACK, BLACK,
    BLACK, BLACK,BLACK, CYAN, BLUE, BLUE, BLUE, BLUE, BLUE, BLUE, BLUE, BLUE, BLUE, BLUE, BLUE, BLUE, CYAN, BLACK, BLACK, BLACK,
    BLACK, BLACK,BLACK, CYAN, BLUE, BLUE, BLUE, BLUE, BLUE, BLUE, BLUE, BLUE, BLUE, BLUE, BLUE, BLUE, CYAN, BLACK, BLACK, BLACK,
    BLACK, BLACK,BLACK, CYAN, CYAN, CYAN, CYAN, BLUE, BLUE, BLUE, BLUE, BLUE, BLUE, CYAN, CYAN, CYAN, CYAN, BLACK, BLACK, BLACK,
    BLACK, BLACK, BLACK,BLACK, BLACK, BLACK, BLACK, BLUE, BLUE, BLUE, BLUE, BLUE, BLUE, BLACK, BLACK, BLACK, BLACK, BLACK, BLACK, BLACK,
    BLACK, BLACK, BLACK,BLACK, BLACK, BLACK, BLACK, BLUE, BLUE, BLUE, BLUE, BLUE, BLUE, BLACK, BLACK, BLACK, BLACK, BLACK, BLACK, BLACK,
    BLACK, BLACK, BLACK, BLACK,BLACK, BLACK, BLACK, BLUE, BLUE, BLUE, BLUE, BLUE, BLUE, BLACK, BLACK, BLACK, BLACK, BLACK, BLACK,  BLACK,
    BLACK, BLACK, BLACK, BLACK, WHITE, WHITE, BLACK, BLUE, BLUE, BLUE, BLUE, BLUE, BLUE, BLACK, WHITE, WHITE, BLACK, BLACK, BLACK,  BLACK,
    BLACK, BLACK, BLACK, WHITE,PURPLE, PURPLE, BLACK, BLUE, BLUE, WHITE, WHITE, BLUE, BLUE, BLACK, PURPLE, PURPLE, WHITE, BLACK, BLACK,  BLACK,
    BLACK, BLACK, BLACK, WHITE,PURPLE, PURPLE, BLACK, BLUE, BLUE, WHITE, WHITE, BLUE, BLUE, BLACK, PURPLE, PURPLE, WHITE, BLACK, BLACK,  BLACK,
    BLACK, BLACK, BLACK, WHITE,PURPLE, PURPLE, BLACK, BLUE, BLUE, WHITE, WHITE, BLUE, BLUE, BLACK, PURPLE, PURPLE, WHITE, BLACK, BLACK,  BLACK,
    BLACK, BLACK, BLACK, BLACK,BLACK, BLACK, BLACK, BLUE, BLUE, WHITE, WHITE, BLUE, BLUE, BLACK, BLACK, BLACK, BLACK, BLACK, BLACK,  BLACK,
    BLACK, BLACK, BLACK, BLACK,BLACK, BLACK, BLACK, BLUE, BLUE, WHITE, WHITE, BLUE, BLUE, BLACK, BLACK, BLACK, BLACK, BLACK, BLACK,  BLACK,
    BLACK, BLACK, BLACK,BLACK, BLACK, BLACK, BLACK, BLUE, BLUE, WHITE, WHITE, BLUE, BLUE, BLACK, BLACK, BLACK, BLACK, BLACK, BLACK,  BLACK,
    BLACK, BLACK, BLACK, BLACK,BLACK, BLACK, BLACK, BLUE, BLUE, WHITE, WHITE, BLUE, BLUE, BLACK, BLACK, BLACK, BLACK, BLACK, BLACK,  BLACK,
    BLACK, BLACK, BLACK, BLACK,BLACK, BLACK, BLACK, BLUE, BLUE, BLACK, BLACK, BLUE, BLUE, BLACK, BLACK, BLACK, BLACK, BLACK, BLACK,  BLACK,
    BLACK, BLACK, BLACK, BLACK,BLACK, BLACK, BLACK, BLUE, BLACK, BLACK, BLACK, BLACK, BLUE, BLACK, BLACK, BLACK, BLACK, BLACK, BLACK,  BLACK,
    BLACK, BLACK, BLACK,BLACK,BLUE, BLUE, BLUE, BLUE, BLACK, BLACK, BLACK, BLACK, BLUE, BLUE, BLUE, BLUE, BLACK, BLACK, BLACK,  BLACK,
    BLACK, WHITE, WHITE, BLACK,BLUE, BLUE, BLUE, BLUE, BLACK, BLACK, BLACK, BLACK, BLUE, BLUE, BLUE, BLUE, BLACK, WHITE, WHITE,   BLACK,
    WHITE, PURPLE, PURPLE,BLACK, BLUE, BLUE, BLUE, BLUE, BLUE, WHITE, WHITE, BLUE, BLUE, BLUE, BLUE, BLUE, BLACK, PURPLE, PURPLE, WHITE,//HERE
    WHITE, PURPLE, PURPLE, BLACK,BLUE, BLUE, BLUE, BLUE, BLUE, WHITE, WHITE, BLUE, BLUE, BLUE, BLUE, BLUE, BLACK, PURPLE, PURPLE,  WHITE,
    WHITE, PURPLE, PURPLE, BLACK,BLUE, BLUE, BLUE, BLUE, BLUE, WHITE, WHITE, BLUE, BLUE, BLUE, BLUE, BLUE, BLACK, PURPLE, PURPLE,  WHITE,
    WHITE, PURPLE, PURPLE, BLACK,BLUE, BLUE, BLUE, BLUE, BLUE, WHITE, WHITE, BLUE, BLUE, BLUE, BLUE, BLUE, BLACK, PURPLE, PURPLE,  WHITE,
    BLACK, BLACK, BLACK, BLACK,BLUE, BLUE, BLUE, BLUE, BLUE, WHITE, WHITE, BLUE, BLUE, BLUE, BLUE, BLUE, BLACK, BLACK, BLACK, BLACK, //HERE 
    BLACK, BLACK, BLACK,BLACK, BLACK, BLACK, BLACK, WHITE, BLACK, BLACK, BLACK, BLACK, WHITE, BLACK, BLACK, BLACK, BLACK, BLACK, BLACK, BLACK, 
    BLACK, BLACK, BLACK,BLACK, BLACK, BLUE, BLUE, BLUE, BLUE, BLUE, BLUE, BLUE, BLUE, BLUE, BLUE, BLACK, BLACK, BLACK, BLACK, BLACK,
    BLACK, BLACK, BLACK, BLACK,BLACK, BLUE, BLUE, BLUE, BLUE, BLUE, BLUE, BLUE, BLUE, BLUE, BLUE, BLACK, BLACK, BLACK, BLACK, BLACK, 
    
};
unsigned char Car3[]={
    BLACK, BLACK, BLACK,BLACK, BLACK, BLUE, BLUE, BLUE, BLUE, BLUE, BLUE, BLUE, BLUE, BLUE, BLUE, BLACK, BLACK, BLACK, BLACK, BLACK,
    BLACK, BLACK, BLACK, BLACK,BLACK, BLUE, BLUE, BLUE, BLUE, BLUE, BLUE, BLUE, BLUE, BLUE, BLUE, BLACK, BLACK, BLACK, BLACK, BLACK, 
    BLACK, BLACK, BLACK,BLACK, BLACK, BLACK, BLACK, WHITE, BLACK, BLACK, BLACK, BLACK, WHITE, BLACK, BLACK, BLACK, BLACK, BLACK, BLACK, BLACK, 
    BLACK, BLACK, BLACK, BLACK,BLUE, BLUE, BLUE, BLUE, BLUE, WHITE, WHITE, BLUE, BLUE, BLUE, BLUE, BLUE, BLACK, BLACK, BLACK, BLACK, 
    WHITE, PURPLE, PURPLE, BLACK,BLUE, BLUE, BLUE, BLUE, BLUE, WHITE, WHITE, BLUE, BLUE, BLUE, BLUE, BLUE, BLACK, PURPLE, PURPLE,  WHITE,
    WHITE, PURPLE, PURPLE, BLACK,BLUE, BLUE, BLUE, BLUE, BLUE, WHITE, WHITE, BLUE, BLUE, BLUE, BLUE, BLUE, BLACK, PURPLE, PURPLE,  WHITE,
    WHITE, PURPLE, PURPLE, BLACK,BLUE, BLUE, BLUE, BLUE, BLUE, WHITE, WHITE, BLUE, BLUE, BLUE, BLUE, BLUE, BLACK, PURPLE, PURPLE,  WHITE,
    WHITE, PURPLE, PURPLE, BLACK,BLUE, BLUE, BLUE, BLUE, BLUE, WHITE, WHITE, BLUE, BLUE, BLUE, BLUE, BLUE, BLACK, PURPLE, PURPLE,  WHITE,
    BLACK, WHITE, WHITE, BLACK,BLUE, BLUE, BLUE, BLUE, BLACK, BLACK, BLACK, BLACK, BLUE, BLUE, BLUE, BLUE, BLACK, WHITE, WHITE,   BLACK,
    BLACK, BLACK, BLACK,BLACK,BLUE, BLUE, BLUE, BLUE, BLACK, BLACK, BLACK, BLACK, BLUE, BLUE, BLUE, BLUE, BLACK, BLACK, BLACK,  BLACK,
    BLACK, BLACK, BLACK, BLACK,BLACK, BLACK, BLACK, BLUE, BLACK, BLACK, BLACK, BLACK, BLUE, BLACK, BLACK, BLACK, BLACK, BLACK, BLACK,  BLACK,
    BLACK, BLACK, BLACK, BLACK,BLACK, BLACK, BLACK, BLUE, BLUE, BLACK, BLACK, BLUE, BLUE, BLACK, BLACK, BLACK, BLACK, BLACK, BLACK,  BLACK,
    BLACK, BLACK, BLACK, BLACK,BLACK, BLACK, BLACK, BLUE, BLUE, WHITE, WHITE, BLUE, BLUE, BLACK, BLACK, BLACK, BLACK, BLACK, BLACK,  BLACK,
    BLACK, BLACK, BLACK, BLACK,BLACK, BLACK, BLACK, BLUE, BLUE, WHITE, WHITE, BLUE, BLUE, BLACK, BLACK, BLACK, BLACK, BLACK, BLACK,  BLACK,
    BLACK, BLACK, BLACK,BLACK, BLACK, BLACK, BLACK, BLUE, BLUE, WHITE, WHITE, BLUE, BLUE, BLACK, BLACK, BLACK, BLACK, BLACK, BLACK,  BLACK,
    BLACK, BLACK, BLACK, BLACK,BLACK, BLACK, BLACK, BLUE, BLUE, WHITE, WHITE, BLUE, BLUE, BLACK, BLACK, BLACK, BLACK, BLACK, BLACK,  BLACK,
    BLACK, BLACK, BLACK, WHITE,PURPLE, PURPLE, BLACK, BLUE, BLUE, WHITE, WHITE, BLUE, BLUE, BLACK, PURPLE, PURPLE, WHITE, BLACK, BLACK,  BLACK,
    BLACK, BLACK, BLACK, WHITE,PURPLE, PURPLE, BLACK, BLUE, BLUE, WHITE, WHITE, BLUE, BLUE, BLACK, PURPLE, PURPLE, WHITE, BLACK, BLACK,  BLACK,
    BLACK, BLACK, BLACK, WHITE,PURPLE, PURPLE, BLACK, BLUE, BLUE, WHITE, WHITE, BLUE, BLUE, BLACK, PURPLE, PURPLE, WHITE, BLACK, BLACK,  BLACK,
    BLACK, BLACK, BLACK, BLACK, WHITE, WHITE, BLACK, BLUE, BLUE, BLUE, BLUE, BLUE, BLUE, BLACK, WHITE, WHITE, BLACK, BLACK, BLACK,  BLACK,
    BLACK, BLACK, BLACK,BLACK, BLACK, BLACK, BLACK, BLUE, BLUE, BLUE, BLUE, BLUE, BLUE, BLACK, BLACK, BLACK, BLACK, BLACK, BLACK, BLACK,
    BLACK, BLACK, BLACK, BLACK,BLACK, BLACK, BLACK, BLUE, BLUE, BLUE, BLUE, BLUE, BLUE, BLACK, BLACK, BLACK, BLACK, BLACK, BLACK,  BLACK,
    BLACK, BLACK, BLACK,BLACK, BLACK, BLACK, BLACK, BLUE, BLUE, BLUE, BLUE, BLUE, BLUE, BLACK, BLACK, BLACK, BLACK, BLACK, BLACK, BLACK,
    BLACK, BLACK,BLACK, CYAN, CYAN, CYAN, CYAN, BLUE, BLUE, BLUE, BLUE, BLUE, BLUE, CYAN, CYAN, CYAN, CYAN, BLACK, BLACK, BLACK,
    BLACK, BLACK,BLACK, CYAN, BLUE, BLUE, BLUE, BLUE, BLUE, BLUE, BLUE, BLUE, BLUE, BLUE, BLUE, BLUE, CYAN, BLACK, BLACK, BLACK,
    BLACK, BLACK,BLACK, CYAN, BLUE, BLUE, BLUE, BLUE, BLUE, BLUE, BLUE, BLUE, BLUE, BLUE, BLUE, BLUE, CYAN, BLACK, BLACK, BLACK,
    BLACK, BLACK, BLACK,CYAN, CYAN, YELLOW, YELLOW, CYAN, BLUE, BLUE, BLUE, BLUE, CYAN, YELLOW, YELLOW, CYAN, CYAN, BLACK, BLACK, BLACK,
    BLACK, BLACK,BLACK, BLACK, BLACK, BLACK, BLACK, BLACK, BLUE, BLACK, BLACK, BLUE, BLACK, BLACK, BLACK, BLACK, BLACK, BLACK, BLACK, BLACK,
    BLACK, BLACK,BLACK, BLACK, BLACK, BLACK, BLACK, BLACK, BLUE, BLUE, BLUE, BLUE, BLACK, BLACK, BLACK, BLACK, BLACK, BLACK, BLACK, BLACK, 
};

unsigned char Heart[]=
{
    GREEN,GREEN,BLACK,BLACK,GREEN,BLACK,BLACK,GREEN,GREEN,
    GREEN,BLACK,RED,RED,BLACK,RED,RED,BLACK,GREEN,
    BLACK,RED,RED,RED,RED,RED,RED,RED,BLACK,
    BLACK,RED,RED,RED,RED,RED,RED,RED,BLACK,
    GREEN,BLACK,RED,RED,RED,RED,RED,BLACK,GREEN,
    GREEN,GREEN,BLACK,RED,RED,RED,BLACK,GREEN,GREEN,
    GREEN,GREEN,GREEN,BLACK,RED,BLACK,GREEN,GREEN,GREEN,
    GREEN,GREEN,GREEN,GREEN,BLACK,GREEN,GREEN,GREEN,GREEN,
};

unsigned char Heart2[]=
{
    GREEN,GREEN,BLACK,BLACK,GREEN,BLACK,BLACK,GREEN,GREEN,
    GREEN,BLACK,PURPLE,PURPLE,BLACK,PURPLE,PURPLE,BLACK,GREEN,
    BLACK,PURPLE,PURPLE,PURPLE,PURPLE,PURPLE,PURPLE,PURPLE,BLACK,
    BLACK,PURPLE,PURPLE,PURPLE,PURPLE,PURPLE,PURPLE,PURPLE,BLACK,
    GREEN,BLACK,PURPLE,PURPLE,PURPLE,PURPLE,PURPLE,BLACK,GREEN,
    GREEN,GREEN,BLACK,PURPLE,PURPLE,PURPLE,BLACK,GREEN,GREEN,
    GREEN,GREEN,GREEN,BLACK,PURPLE,BLACK,GREEN,GREEN,GREEN,
    GREEN,GREEN,GREEN,GREEN,BLACK,GREEN,GREEN,GREEN,GREEN,
};

unsigned char Coin[]=
{
  GREEN,GREEN,GREEN,BLACK,BLACK,GREEN,GREEN,GREEN,
  GREEN,GREEN,BLACK,WHITE,WHITE,BLACK,GREEN,GREEN,
  GREEN,BLACK,WHITE,YELLOW,YELLOW,YELLOW,BLACK,GREEN,
  BLACK,YELLOW,WHITE,YELLOW,BLACK,YELLOW,YELLOW,BLACK,
  BLACK,YELLOW,WHITE,YELLOW,BLACK,YELLOW,YELLOW,BLACK,
  GREEN,BLACK,WHITE,YELLOW,YELLOW,YELLOW,BLACK,GREEN,
  GREEN,GREEN,BLACK,WHITE,WHITE,BLACK,GREEN,GREEN,
  GREEN,GREEN,GREEN,BLACK,BLACK,GREEN,GREEN,GREEN,
  
};

unsigned char Bricks[] = {
  RED,RED,RED,RED,RED,RED,BLACK,RED,RED,RED,RED,RED,BLACK,RED,RED,RED,RED,
  RED,RED,RED,RED,RED,RED,BLACK,RED,RED,RED,RED,RED,BLACK,RED,RED,RED,RED,
  BLACK,BLACK,BLACK,BLACK,BLACK,BLACK,BLACK,BLACK,BLACK,BLACK,BLACK,BLACK,BLACK,BLACK,BLACK,BLACK,BLACK,
  RED,RED,RED,RED,BLACK,RED,RED,RED,RED,RED,BLACK,RED,RED,RED,RED,RED,RED,
  RED,RED,RED,RED,BLACK,RED,RED,RED,RED,RED,BLACK,RED,RED,RED,RED,RED,RED,
  BLACK,BLACK,BLACK,BLACK,BLACK,BLACK,BLACK,BLACK,BLACK,BLACK,BLACK,BLACK,BLACK,BLACK,BLACK,BLACK,BLACK,
  RED,RED,BLACK,RED,RED,RED,RED,RED,BLACK,RED,RED,RED,RED,RED,BLACK,RED,RED,
  RED,RED,BLACK,RED,RED,RED,RED,RED,BLACK,RED,RED,RED,RED,RED,BLACK,RED,RED, 
};

unsigned char Person[] = {
    GREEN, GREEN, GREEN, YELLOW, YELLOW, YELLOW, YELLOW, GREEN, GREEN,GREEN,
    GREEN, GREEN, YELLOW, YELLOW, WHITE, WHITE, YELLOW, YELLOW, GREEN, GREEN,   
    GREEN, GREEN, YELLOW, WHITE, WHITE, CYAN, WHITE, GREEN, GREEN,GREEN,
    GREEN, GREEN, YELLOW, WHITE, WHITE, WHITE, WHITE, GREEN, GREEN,GREEN,    
    GREEN, GREEN, YELLOW, WHITE, WHITE, WHITE, GREEN, GREEN, GREEN,GREEN,    
    GREEN, GREEN, BLUE, WHITE, WHITE, WHITE, BLUE, GREEN, GREEN,GREEN,   
    GREEN, BLUE, BLUE, BLUE, WHITE, BLUE, BLUE, BLUE, GREEN,GREEN,   
    GREEN, WHITE, BLUE, BLUE, BLACK, BLUE, BLUE, WHITE, GREEN,GREEN,
    GREEN, WHITE, BLUE, BLUE, BLACK, BLUE, BLUE, WHITE, GREEN,GREEN,   
    GREEN, WHITE, BLUE, BLUE, WHITE, BLUE, BLUE, WHITE, GREEN,GREEN,
    GREEN, GREEN, CYAN, CYAN, CYAN, CYAN, CYAN, GREEN, GREEN,GREEN,
    GREEN, GREEN, CYAN, CYAN, CYAN, CYAN, CYAN, GREEN, GREEN,GREEN,
    GREEN, GREEN, CYAN, CYAN, CYAN, CYAN, CYAN, GREEN, GREEN,GREEN,
    GREEN, GREEN, GREEN, WHITE, GREEN, WHITE, GREEN, GREEN, GREEN,GREEN,
    GREEN, GREEN, GREEN, WHITE, GREEN, GREEN, WHITE, GREEN, GREEN,GREEN,
    GREEN, GREEN, GREEN, WHITE, GREEN, GREEN, GREEN, WHITE, GREEN,GREEN,
    GREEN, GREEN, RED, RED, GREEN, RED, RED, GREEN, GREEN,GREEN,  

};

unsigned char Person2[] = {
    GREEN,GREEN, GREEN, GREEN, YELLOW, YELLOW, YELLOW, YELLOW, GREEN, GREEN,GREEN,
    GREEN,GREEN, GREEN, YELLOW, YELLOW, WHITE, WHITE, YELLOW, YELLOW, GREEN,GREEN,
    GREEN,GREEN, GREEN, YELLOW, WHITE, WHITE, CYAN, WHITE, GREEN, GREEN,GREEN,
    GREEN,GREEN, GREEN, YELLOW, WHITE, WHITE, WHITE, WHITE, GREEN, GREEN,GREEN,
    GREEN,GREEN, GREEN, YELLOW, WHITE, WHITE, WHITE, GREEN, GREEN, GREEN,GREEN,    
    GREEN,GREEN, GREEN, BLUE, WHITE, WHITE, WHITE, BLUE, GREEN, GREEN,GREEN,
    GREEN,GREEN, BLUE, BLUE, BLUE, WHITE, BLUE, BLUE, BLUE, GREEN,GREEN,   
    GREEN,GREEN, WHITE, BLUE, BLUE, BLACK, BLUE, BLUE, WHITE, GREEN,GREEN,
    GREEN,WHITE, GREEN, BLUE, BLUE, BLACK, BLUE, BLUE, GREEN, WHITE,GREEN,   
    WHITE,GREEN, GREEN, BLUE, BLUE, WHITE, BLUE, BLUE, GREEN, GREEN,WHITE,
    GREEN,GREEN, GREEN, CYAN, CYAN, CYAN, CYAN, CYAN, GREEN, GREEN,GREEN,
    GREEN,GREEN, GREEN, CYAN, CYAN, CYAN, CYAN, CYAN, GREEN, GREEN,GREEN,
    GREEN,GREEN, GREEN, CYAN, CYAN, CYAN, CYAN, CYAN, GREEN, GREEN,GREEN,
    GREEN,GREEN, GREEN, GREEN, WHITE, GREEN, WHITE, GREEN, GREEN, GREEN,GREEN,
    GREEN,GREEN, GREEN, GREEN, WHITE, GREEN, WHITE, GREEN, GREEN, GREEN,GREEN,
    GREEN,GREEN, GREEN, GREEN, WHITE, GREEN, WHITE, GREEN, GREEN, GREEN,GREEN,
    GREEN,GREEN, GREEN, RED, RED, GREEN, RED, RED, GREEN, GREEN,GREEN,    

};

unsigned char Title[]={
   BLACK,BLACK,BLACK,BLACK,BLACK,BLACK,BLACK,WHITE,WHITE,
   WHITE,BLACK,WHITE,WHITE,WHITE,WHITE,WHITE,BLACK,WHITE,
   WHITE,BLACK,WHITE,WHITE,WHITE,WHITE,WHITE,WHITE,BLACK,
   WHITE,BLACK,WHITE,WHITE,WHITE,WHITE,WHITE,WHITE,BLACK,
   WHITE,BLACK,WHITE,WHITE,WHITE,WHITE,WHITE,WHITE,BLACK,
   WHITE,BLACK,WHITE,WHITE,WHITE,WHITE,WHITE,WHITE,BLACK,
   WHITE,BLACK,WHITE,WHITE,WHITE,WHITE,WHITE,WHITE,BLACK,
   WHITE,BLACK,WHITE,WHITE,WHITE,WHITE,WHITE,BLACK,WHITE,
   BLACK,BLACK,BLACK,BLACK,BLACK,BLACK,BLACK,WHITE,WHITE,
};

unsigned char Cone[] = {
   RED,BLACK,RED,BLACK,RED,
   WHITE,WHITE,WHITE,WHITE,WHITE,
   BLACK,WHITE,WHITE,WHITE,BLACK,
   WHITE,WHITE,WHITE,WHITE,WHITE,
};
unsigned char Trap[] = { 
    BLACK,WHITE, BLACK, WHITE, BLACK, WHITE, BLACK, WHITE, BLACK, WHITE, BLACK, WHITE, BLACK, WHITE, BLACK, WHITE, BLACK, WHITE, BLACK,
    WHITE,WHITE, WHITE, WHITE, WHITE, WHITE, WHITE, WHITE, WHITE, WHITE, WHITE, WHITE, WHITE, WHITE, WHITE, WHITE, WHITE, WHITE, WHITE,
};

unsigned char Arrow[]={
  BLACK,BLACK,BLACK,BLACK,GREEN,GREEN,BLACK,BLACK,BLACK,BLACK,
  BLACK,BLACK,BLACK,GREEN,GREEN,GREEN,BLACK,BLACK,BLACK,BLACK,
  BLACK,BLACK,GREEN,GREEN,BLACK,GREEN,GREEN,GREEN,GREEN,GREEN,
  BLACK,GREEN,GREEN,BLACK,BLACK,BLACK,BLACK,BLACK,BLACK,GREEN,
  GREEN,GREEN,BLACK,BLACK,BLACK,BLACK,BLACK,BLACK,BLACK,GREEN,
  BLACK,GREEN,GREEN,BLACK,BLACK,BLACK,BLACK,BLACK,BLACK,GREEN,
  BLACK,BLACK,GREEN,GREEN,BLACK,GREEN,GREEN,GREEN,GREEN,GREEN,
  BLACK,BLACK,BLACK,GREEN,GREEN,GREEN,BLACK,BLACK,BLACK,BLACK,
  BLACK,BLACK,BLACK,BLACK,GREEN,GREEN,BLACK,BLACK,BLACK,BLACK,
};

unsigned char Skull[]=
{
  RED,RED,RED,RED,RED,BLACK,BLACK,BLACK,BLACK,BLACK,BLACK,BLACK,BLACK,BLACK,BLACK,BLACK,RED,RED,RED,RED,RED,
  RED,RED,RED,BLACK,BLACK,BLACK,WHITE,WHITE,WHITE,WHITE,WHITE,WHITE,WHITE,WHITE,WHITE,BLACK,BLACK,BLACK,RED,RED,RED,
  RED,RED,BLACK,BLACK,WHITE,WHITE,WHITE,WHITE,WHITE,WHITE,WHITE,WHITE,WHITE,WHITE,WHITE,WHITE,WHITE,BLACK,BLACK,RED,RED,
  RED,BLACK,BLACK,WHITE,WHITE,WHITE,WHITE,WHITE,WHITE,WHITE,WHITE,WHITE,WHITE,WHITE,WHITE,WHITE,WHITE,WHITE,BLACK,BLACK,RED,
  RED,BLACK,BLACK,WHITE,WHITE,WHITE,BLACK,BLACK,BLACK,WHITE,WHITE,WHITE,BLACK,BLACK,BLACK,WHITE,WHITE,WHITE,BLACK,BLACK,RED,
  BLACK,BLACK,WHITE,WHITE,BLACK,BLACK,BLACK,BLACK,WHITE,WHITE,WHITE,WHITE,WHITE,BLACK,BLACK,BLACK,BLACK,WHITE,WHITE,BLACK,BLACK,
  BLACK,WHITE,WHITE,BLACK,BLACK,BLACK,BLACK,BLACK,WHITE,WHITE,WHITE,WHITE,WHITE,BLACK,BLACK,BLACK,BLACK,BLACK,WHITE,WHITE,BLACK,
  BLACK,WHITE,WHITE,BLACK,BLACK,BLACK,BLACK,BLACK,WHITE,WHITE,WHITE,WHITE,WHITE,BLACK,BLACK,BLACK,BLACK,BLACK,WHITE,WHITE,BLACK,
  BLACK,WHITE,WHITE,BLACK,BLACK,BLACK,BLACK,WHITE,WHITE,WHITE,WHITE,WHITE,WHITE,WHITE,BLACK,BLACK,BLACK,BLACK,WHITE,WHITE,BLACK,
  BLACK,WHITE,WHITE,BLACK,BLACK,BLACK,WHITE,WHITE,WHITE,WHITE,WHITE,WHITE,WHITE,WHITE,WHITE,BLACK,BLACK,BLACK,WHITE,WHITE,BLACK,
  BLACK,WHITE,WHITE,WHITE,WHITE,WHITE,WHITE,WHITE,BLACK,WHITE,WHITE,WHITE,BLACK,WHITE,WHITE,WHITE,WHITE,WHITE,WHITE,WHITE,BLACK,
  BLACK,WHITE,WHITE,WHITE,WHITE,WHITE,WHITE,BLACK,BLACK,WHITE,WHITE,WHITE,BLACK,BLACK,WHITE,WHITE,WHITE,WHITE,WHITE,WHITE,BLACK,
  BLACK,WHITE,WHITE,WHITE,WHITE,WHITE,WHITE,BLACK,BLACK,WHITE,WHITE,WHITE,BLACK,BLACK,WHITE,WHITE,WHITE,WHITE,WHITE,WHITE,BLACK,
  BLACK,BLACK,WHITE,WHITE,WHITE,WHITE,WHITE,WHITE,WHITE,WHITE,WHITE,WHITE,WHITE,WHITE,WHITE,WHITE,WHITE,WHITE,WHITE,BLACK,BLACK,
  RED,BLACK,WHITE,WHITE,BLACK,WHITE,WHITE,WHITE,WHITE,WHITE,WHITE,WHITE,WHITE,BLACK,WHITE,WHITE,BLACK,WHITE,WHITE,BLACK,RED,
  RED,BLACK,BLACK,BLACK,BLACK,WHITE,WHITE,BLACK,WHITE,BLACK,WHITE,BLACK,WHITE,BLACK,WHITE,WHITE,BLACK,BLACK,BLACK,BLACK,RED,
  RED,RED,RED,RED,BLACK,WHITE,WHITE,BLACK,WHITE,BLACK,WHITE,BLACK,WHITE,BLACK,WHITE,WHITE,BLACK,RED,RED,RED,RED,
  RED,RED,RED,RED,BLACK,BLACK,BLACK,BLACK,BLACK,BLACK,BLACK,BLACK,BLACK,BLACK,BLACK,BLACK,BLACK,RED,RED,RED,RED,
  RED,RED,RED,RED,RED,RED,RED,RED,RED,RED,RED,RED,RED,RED,RED,RED,RED,RED,RED,RED,RED,
  RED,RED,RED,RED,BLACK,BLACK,BLACK,BLACK,BLACK,BLACK,BLACK,BLACK,BLACK,BLACK,BLACK,BLACK,BLACK,RED,RED,RED,RED,
  RED,RED,RED,RED,BLACK,WHITE,BLACK,WHITE,BLACK,WHITE,BLACK,WHITE,BLACK,WHITE,BLACK,WHITE,BLACK,RED,RED,RED,RED,
  RED,RED,RED,RED,BLACK,WHITE,WHITE,WHITE,WHITE,WHITE,WHITE,WHITE,WHITE,WHITE,WHITE,WHITE,BLACK,RED,RED,RED,RED,
  RED,RED,RED,RED,BLACK,BLACK,BLACK,BLACK,BLACK,BLACK,BLACK,BLACK,BLACK,BLACK,BLACK,BLACK,BLACK,RED,RED,RED,RED,
};

void StartUp(){
  
      VGA.setColor(RED);
      VGA.printtext(30,10," DEATH RACE ");
      VGA.writeArea(40,20 ,80,21, Intro);
      VGA.setBackgroundColor(BLACK);
      VGA.setColor(WHITE);
      VGA.printtext(60,45,"Start"); 
      VGA.printtext(60,65,"About"); 
      if(arrow==1){
        VGA.setColor( BLACK );
        VGA.drawRect( 60, 45, 40,10 );
        VGA.writeArea(100,45,10,9,Arrow);
        VGA.drawRect( 100,65, 10,9 );
      }else{
        VGA.setColor( BLACK);
        VGA.drawRect( 60, 65, 40,10 );
        VGA.drawRect( 100,45, 10,9 );
        VGA.writeArea(100,65,10,9,Arrow);
        
      }
      if(digitalRead(FPGA_BTN_0))
        if(arrow==1)
        {
           for(int i=0; i<10; i++){
             if(i%2==0){
                VGA.setBackgroundColor(BLACK);
                VGA.printtext(60,45,"Start");
             }else{
                VGA.setBackgroundColor(RED);
                VGA.printtext(60,45,"Start");
             }
             delay(150);
             Start = 1;
           }
        }else{
           Start=2;
           VGA.clear();
        }
       if(digitalRead(FPGA_SW_0))
         arrow=1;
       else
         arrow=0;
}

 struct Line lines[LineAmount];
 struct Obstacule Obstacules[ObstaculeAmount];
 void InitializePositionsObstacules(int x1,int x2,int x3, unsigned char* objectToInstant,int width , int height, int index){
   Obstacules[index].posY=0;
   Obstacules[index].XPosiblePosition[0]=x1;
   Obstacules[index].XPosiblePosition[1]=x2;
   Obstacules[index].XPosiblePosition[2]=x3;
   Obstacules[index].posX= Obstacules[index].XPosiblePosition[rand()%XPositionAmount];
   Obstacules[index].objectToInstantiate=objectToInstant;
   Obstacules[index].width = width;
   Obstacules[index].height= height;
 }
  
  
 void InitializeObstacules()
 {
   InitializePositionsObstacules(47,83,115,Car3,20,29,0);
   InitializePositionsObstacules(50,83,118,Bricks,17,8,1);
   InitializePositionsObstacules(55,90,123,Cone,5,4,2);
   InitializePositionsObstacules(50,85,118,Trap,19,2,3);
 }
 struct Sprite car;
 void InitCarPosition()
 {
   car.posX=83;
   car.posY=75;
   car.width =20;
   car.height=29;
   car.image = Car;
 }
void setup(){
   srand(0);
  VGA.begin(VGAWISHBONESLOT(9),CHARMAPWISHBONESLOT(10));
  Serial.begin(9600);
  
  VGA.clear();
  VGA.setBackgroundColor(BLACK);
  VGA.setColor(RED);
  
  
  //VGA.writeArea(0,0, 9, 9, Title);
  delay(1000);
  int  i,x1 =73, x2=107,y1=0, y2=0;
  for(i = 0 ; i<LineAmount;i++)
  {
      lines[i].x1 = x1;
       lines[i].y1= y1;
      lines[i].x2 =x2;
     lines[i].y2 = y2;
     y1=y2+=20;
        
   }
   InitCarPosition();
   InitializeObstacules();
  //DrawLimits();

  //Loading();
  
}

void Loading(){
  
  /*for(int i = 0; i < 100; i++){
    if(i%2==0){
      VGA.putPixel(i, 71, GREEN);
      VGA.putPixel(i, 70, GREEN);
    }else{ 
      VGA.putPixel(i, 71, CYAN);
      VGA.putPixel(i, 70, CYAN);
    }
    delay(50);
  
  }*/
  char* buffer;
  
  for(int i = 0; i < 100; i++){
    if(i%2==0){
      VGA.putPixel(i, 75, WHITE);
      VGA.putPixel(i, 74, WHITE);
    }else{ 
      VGA.putPixel(i, 75, CYAN);
      VGA.putPixel(i, 74, CYAN);
    }

    VGA.printtext(i+5, 72, buffer);
    delay(1000);
  }
}

void DrawLimits(){
  for(int i =0 ; i<120; i++){
    if(i%4==0){
      //LEFT
      VGA.putPixel(41, i, WHITE);
      VGA.putPixel(42, i, WHITE);

      //RIGHT
      VGA.putPixel(141, i, WHITE);
      VGA.putPixel(142, i, WHITE);

    }
    //LEFT
    VGA.putPixel(40, i, WHITE);
    VGA.putPixel(43, i, WHITE);
    //RIGHT
    VGA.putPixel(140, i, WHITE);
    VGA.putPixel(143, i, WHITE);
  }
}

void DrawObject(){
 
      VGA.clear();
      
       // VGA.writeArea(105, 70-(i*8), 20, 29, Car2);
      if(Start==1)
      {
        VGA.setColor( GREEN );
      
        VGA.drawRect( 0, 10, 40, 118 );
        VGA.drawRect( 144, 0, 15, 119 );
        VGA.setBackgroundColor(CYAN);
        VGA.setColor( BLACK );
       
       
        VGA.setColor( RED );
        char* buffers="";
        itoa(Score,buffers,10);
        VGA.printtext(0,0,"Score");
        VGA.writeArea(0, 11, 8, 8, Coin);
        VGA.printtext(9,11,buffers,true );
        
        DrawPerson();
        DrawLines();
        DrawLimits();
        
        if(!TrafficLight){
          TrafficLightAnimation(); 
          TrafficLight=true;
        }
        DrawObstacules();
        DrawCar();
        
        Score++;
        DrawLives();
      }
    //TESTING DIMENSIONS
    VGA.putPixel(0,0,GREEN);
    VGA.putPixel(0,119,RED);
    VGA.putPixel(158,0,GREEN);
    VGA.putPixel(158,119,GREEN);    
}

void TrafficLightAnimation()
{
    VGA.setColor( WHITE );
    VGA.drawRect( 44, 12, 97, 35 );
    VGA.writeArea(83, 15, 16, 30, TrafficLightRed);
    delay(800);
    VGA.writeArea(83, 15, 16, 30, TrafficLightYellow);
    delay(800);
    VGA.writeArea(83, 15, 16, 30, TrafficLightGreen);
    delay(800);
    VGA.drawRect( 44, 12, 97, 35 );
    VGA.setColor( BLACK );
    VGA.setBackgroundColor(WHITE);
    VGA.printtext(83,25,"GO");
    delay(500);
}

void DrawPerson()
{
  if(PersonAnimation==0)
    VGA.writeArea(15, 90, 10, 17, Person);
  else
    VGA.writeArea(15, 90, 11, 17, Person2);
  PersonAnimation++;
  
  if(PersonAnimation>1)
    PersonAnimation=0;
}

int CheckBounds(int currentPos, boolean direction){
  if(direction)
    if(currentPos==115)
      return 83;
    else 
      return 49;
  else
    if(currentPos==49)
      return 83;
    else 
       return 115;    
}

void DrawCar()
{
  if(digitalRead(FPGA_BTN_1))
    car.posX = CheckBounds(car.posX, true);
  else if(digitalRead(FPGA_BTN_0))
    car.posX = CheckBounds(car.posX, false);
    
    //if(CarAnimation==0)
      VGA.writeArea(car.posX, car.posY, car.width, car.height, car.image);
    //else
      //VGA.writeArea(car.posX, car.posY+1, car.width, car.height, car.image);
      
   // CarAnimation++;
   // if(CarAnimation>1)
   // CarAnimation=0;
}

void DrawLine(int posX, int posY)
{
   VGA.setColor( WHITE );
   VGA.drawRect( posX, posY, 4, 6 );
}

void DrawLives()
{
  int pos =6;
  if(Lives==0)
  {  
    FinishGame=true;
    VGA.clear();
  }
  else
  {
    for(int i=0;i<Lives;i++)
    {
      if(HeartAnimation==0)
        VGA.writeArea(pos,110 , 9, 8, Heart);
      else
        VGA.writeArea(pos,110 , 9, 8, Heart2);
      pos+=10;
    }
  }
}

void DrawObstacules()
{
     struct Obstacule *obstacule= &Obstacules[obstaculeToInstantIndex];
     Rectangle r1 ={obstacule->posX,obstacule->posY,(obstacule->posX+obstacule->width),(obstacule->posY+obstacule->height) };
     Rectangle r2 ={car.posX,car.posY,(car.posX+car.width),(car.posY+car.height) };
     delay(10);
     int collide =Collide(&r1, &r2);
     
     if(collide ==1)
     {
       char *buffer ="";
       itoa(obstacule->posY,buffer,10); 
       Serial.print("Colision: ");
       Serial.println(buffer);
       //InitializeObstacules();
       obstacule->posY=96;
       Lives--;
     }
    //obstaculeToInstantIndex = rand() % ObstaculeAmount;   
    if(obstacule->posY>95)
    {  
       char *buffer ="";
       itoa(obstacule->posY,buffer,10);
       Serial.print("OOR: "); 
       Serial.println(buffer);
       //InitializeObstacules();
       obstaculeToInstantIndex = rand() % ObstaculeAmount;
       obstacule = &Obstacules[obstaculeToInstantIndex];
       obstacule->posX= obstacule->XPosiblePosition[rand()%XPositionAmount];  
       obstacule->posY=0;

    }
    VGA.writeArea(obstacule->posX, obstacule->posY,obstacule->width, obstacule->height, obstacule->objectToInstantiate); 
    obstacule->posY +=3;
   
}

void DrawLines()
{
  
   for(int i = 0;i<LineAmount;i++)
   {
     DrawLine(lines[i].x1, lines[i].y1) ;
     DrawLine(lines[i].x2, lines[i].y2) ;
     if( lines[i].y1>110)
       lines[i].y1=0;
     if( lines[i].y2>110)
       lines[i].y2=0;
     lines[i].y1+=10;
     lines[i].y2+=10;
   }
}

void About()
{
    VGA.setColor(RED);
    VGA.printtext(50,10," ABOUT ");
    VGA.printtext(20,30," Mario Ibarra ");
    VGA.printtext(20,40," Edward Siwady ");
    VGA.printtext(14,50," Erick Caballero ");
    if(digitalRead(FPGA_BTN_3)){
      Start=0;
      VGA.clear();
    }
}
  
void loop(){
    //if(Lives!=0
  
  
  if(Start==0){
        VGA.printtext(40,0,"Death Race");
        StartUp();
  }else if(Start==1 && !FinishGame){
        DrawObject();
         delay(150);
  }else if(Start==2){
    About();
  }else if(FinishGame)
  {
    VGA.clear();
    VGA.setBackgroundColor(BLACK);
    VGA.setColor(RED);
    VGA.printtext(45,45,"GAME OVER");
    VGA.writeArea(70,55 ,21, 23, Skull);
  }
}
